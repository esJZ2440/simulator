## Kconfig
```kconfig
#
# For a description of the syntax of this configuration file,
# see docs/Kconfig-language.txt.
#

mainmenu "Configuration"

config MAIN_DEMO
	bool "MAIN_DEMO_TYPE"
	default y
	help
	  Demo option.

source startup/Kconfig
source drivers/Kconfig
source user/Kconfig
```

## drivers/Kconfig
```kconfig
menu "Drivers"

config DRIVER_DEMO
	bool "DRIVER_DEMO_TYPE"
	default y
	help
	  Demo option.

endmenu
```

## startup/Kconfig
```kconfig
menu "Startup"

config STARTUP_DEMO
	bool "STARTUP_DEMO_TYPE"
	default y
	help
	  Demo option.

endmenu
```

## user/Kconfig
```kconfig
menu "User"

config USER_DEMO
	bool "USER_DEMO_TYPE"
	default y
	help
	  Demo option.

endmenu
```
